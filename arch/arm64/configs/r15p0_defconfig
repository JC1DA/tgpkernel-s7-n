## arch/arm64/configs/r15p0_defconfig
```kconfig
#
# Modifications for r15p0 GPU Drivers
#
# CONFIG_MALI_R12P0 is not set
CONFIG_MALI_R15P0=y
CONFIG_MALI_PLATFORM_THIRDPARTY_NAME="exynos"
CONFIG_EXYNOS_SOC_NAME="8890"
CONFIG_MALI_MIDGARD=y
CONFIG_MALI_FENCE_DEBUG=y
CONFIG_MALI_SEC_CL_BOOST=y
CONFIG_MALI_SEC_UTILIZATION=y
CONFIG_MALI_PM_QOS=y
CONFIG_MALI_BTS_OPTIMIZATION=y
CONFIG_MALI_DEBUG_KERNEL_SYSFS=y
CONFIG_MALI_EXYNOS_SECURE_RENDERING=y
CONFIG_MALI_SEC_ASP_SECURE_BUF_CTRL=y
CONFIG_GPU_TRACEPOINTS=y
```
